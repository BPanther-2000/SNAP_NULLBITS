## config/west.yml
```yaml
manifest:
  remotes:
    - name: zmkfirmware
      url-base: https://github.com/BPanther-2000
  projects:
    - name: SNAP_BONGOCAT
      remote: zmkfirmware
      revision: main
      import: app/west.yml
  self:
    path: config
```
